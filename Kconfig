## dts/bindings/input_processors/zmk,input-processor-keytoggle.yaml
```yaml
# Copyright (c) 2024, The ZMK Contributors
# SPDX-License-Identifier: MIT

description: Input Processor for key toggling behavior.

compatible: "zmk,input-processor-keytoggle"

include: ip_zero_param.yaml

properties:
  "#input-processor-cells":
    type: int
    const: 0
  bindings:
    description: "Behavior to be invoked"
    type: phandle-array
    required: true
  release-delay-ms:
    description: "Time to wait (in milliseconds) after the last movement event before releasing the key. If omitted, it will be set to 100."
    type: int
    default: 100
  tap-ms:
    description: "Time to wait (in milliseconds) between the press and release events on a triggered behavior binding for the initial press. If omitted, it will be set to 0."
    type: int
    default: 0
  wait-ms:
    description: "Time to wait (in milliseconds) before triggering the next behavior binding. If omitted, it will be set to 0."
    type: int
    default: 0
```

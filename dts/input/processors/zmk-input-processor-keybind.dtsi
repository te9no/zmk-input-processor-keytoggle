/*
 * Copyright (c) 2024 The ZMK Contributors
 *
 * SPDX-License-Identifier: MIT
 */

/dts-v1/;

#include <dt-bindings/zmk/keys.h>
#include <dt-bindings/zmk/input-processor-keytoggle.h>

/ {
    input_processors {
        zip_keytoggle: zip_keytoggle {
            compatible = "zmk,input-processor-keytoggle";
            #input-processor-cells = <0>;
            keycode = <LS(MCLK)>; // Example keycode, replace with your desired keycode
        };
    };
};


